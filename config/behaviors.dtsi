&mt {
  flavor = "balanced";
  tapping-term-ms = <TAPPING_TERM_MS>;
  quick-tap-ms = <QUICK_TAP_MS>;
  require-prior-idle-ms = <GLOBAL_QUICK_TAP_MS>;
};

&lt {
  flavor = "balanced";
  tapping-term-ms = <TAPPING_TERM_MS>;
  quick-tap-ms = <QUICK_TAP_MS>;
  require-prior-idle-ms = <GLOBAL_QUICK_TAP_MS>;
};

&sk {
  quick-release;
};

// mods deactivate caps-word, requires PR https://github.com/zmkfirmware/zmk/pull/1451
// &caps_word {
//   /delete-property/ ignore-modifiers;
// };

// From: https://github.com/urob/zmk-config/
// num-word, requires PR https://github.com/zmkfirmware/zmk/pull/1451
// Adds arrows and shift to smart layer for more comfortable navigation/selection moves
//&num_word {
//  layers = <L2>;
//  continue-list = <BSPC DEL DOT COMMA PLUS MINUS STAR FSLH EQUAL RSHFT LEFT RIGHT UP DOWN>;
//};

/ {
    /*
     - tap: backspace
     - hold: repeat backspace
     - shift + tap: delete
     - shift + hold: repeat delete

     From: https://zmk.dev/docs/behaviors/mod-morph#advanced-configuration
     */
    /omit-if-no-ref/ bkspc_del: backspace_delete {
      label = "BACKSPACE_DELETE";
      compatible = "zmk,behavior-mod-morph";
      bindings = <&kp BACKSPACE>, <&kp DELETE>;
      mods = <(MOD_LSFT|MOD_RSFT)>;
      #binding-cells = <0>;
    };

    /*
     - tap: next track
     - shift + tap: prev track
     */
    /omit-if-no-ref/ next_prev: next_prev {
      label = "NEXT_PREV_TRACK";
      compatible = "zmk,behavior-mod-morph";
      bindings = <&kp C_NEXT>, <&kp C_PREV>;
      mods = <(MOD_LSFT|MOD_RSFT)>;
      #binding-cells = <0>;
    };

    /*
     - tap: volume up
     - shift + tap: volume down
     */
    /omit-if-no-ref/ volume: volume {
      label = "VOLUME";
      compatible = "zmk,behavior-mod-morph";
      bindings = <&kp C_VOL_UP>, <&kp C_VOL_DN>;
      mods = <(MOD_LSFT|MOD_RSFT)>;
      #binding-cells = <0>;
    };
  };
};