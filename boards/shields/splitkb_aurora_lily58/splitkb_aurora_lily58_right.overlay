/*
 * Copyright (c) 2022 The ZMK Contributors
 *
 * SPDX-License-Identifier: MIT
 */

#include "splitkb_aurora_lily58.dtsi"
#include "splitkb_aurora_lily58_ps2.dtsi"

/ {
    chosen {
        zmk,kscan = &kscan;
    };

    kscan: kscan {
        compatible = "zmk,kscan-gpio-matrix";
        wakeup-source;

        diode-direction = "row2col";

        row-gpios
            = <&pro_micro 21 GPIO_ACTIVE_HIGH>
            , <&pro_micro 4  GPIO_ACTIVE_HIGH>
            , <&pro_micro 14 GPIO_ACTIVE_HIGH>
            , <&pro_micro 16 GPIO_ACTIVE_HIGH>
            , <&pro_micro 10 GPIO_ACTIVE_HIGH>
            ;

        col-gpios
            = <&pro_micro 9  (GPIO_PULL_DOWN | GPIO_ACTIVE_HIGH)>
            , <&pro_micro 8  (GPIO_PULL_DOWN | GPIO_ACTIVE_HIGH)>
            , <&pro_micro 7  (GPIO_PULL_DOWN | GPIO_ACTIVE_HIGH)>
            , <&pro_micro 6  (GPIO_PULL_DOWN | GPIO_ACTIVE_HIGH)>
            , <&pro_micro 5  (GPIO_PULL_DOWN | GPIO_ACTIVE_HIGH)>
            , <&pro_micro 15 (GPIO_PULL_DOWN | GPIO_ACTIVE_HIGH)>
            ;
    };
};

&default_transform {
    col-offset = <6>;
};
